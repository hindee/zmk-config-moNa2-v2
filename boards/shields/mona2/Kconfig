## boards/shields/mona2/Kconfig
```kconfig
menu "moNa2 shield options"

config PMW3610
    bool "Enable PMW3610 trackball sensor"
    default y
    help
      Enable the PMW3610 trackball/optical sensor driver (pixart,pmw3610).

endmenu
```

## config/west.yml
```yaml
manifest:
  defaults:
    revision: main
  remotes:
    - name: cormoran
      url-base: https://github.com/cormoran
    - name: badjeff    # <-- PMW3610
      url-base: https://github.com/badjeff
    # - name: sekigon-gonnoc  # <-- PAW3222
    #   url-base: https://github.com/sekigon-gonnoc
    - name: caksoylar  # <-- RGB LED
      url-base: https://github.com/caksoylar
    - name: zettaface  # <-- Input Processor Keybind
      url-base: https://github.com/zettaface
    - name: kot149
      url-base: https://github.com/kot149
    - name: nuovotaka
      url-base: https://github.com/nuovotaka

  projects:
    # ZMK: DYA Studio 用カスタム RPC サブシステム付き cormoran fork
    - name: zmk
      remote: cormoran
      revision: v0.3-branch+dya
      import: app/west.yml

    # DYA Studio スタック (すべて cormoran リポジトリ)
    - name: zmk-module-ble-management
      remote: cormoran
      revision: main
      path: modules/zmk-module-ble-management
    - name: zmk-module-battery-history
      remote: cormoran
      revision: main
      path: modules/zmk-module-battery-history
    - name: zmk-module-settings-rpc
      remote: cormoran
      revision: main
      path: modules/zmk-module-settings-rpc
    - name: zmk-module-runtime-input-processor
      remote: cormoran
      revision: main
      path: modules/zmk-module-runtime-input-processor
    - name: zmk-behavior-runtime-sensor-rotate
      remote: cormoran
      revision: main
      path: modules/zmk-behavior-runtime-sensor-rotate

    # その他
    - name: zmk-pmw3610-driver
      remote: badjeff
      revision: b7e61de
      path: modules/zmk-pmw3610-driver
    # - name: zmk-driver-paw3222
    #   remote: sekigon-gonnoc
    #   revision: main

    - name: zmk-rgbled-widget
      remote: caksoylar
      revision: 0efe481
      path: modules/zmk-rgbled-widget
    - name: zmk-input-processor-keybind
      remote: zettaface
      revision: main
      path: modules/zmk-input-processor-keybind
    - name: zmk-scroll-snap
      remote: kot149
      revision: v1
      path: modules/zmk-scroll-snap
    - name: zmk-pointing-acceleration-alpha
      remote: nuovotaka
      revision: main
      path: modules/zmk-pointing-acceleration-alpha
    - name: zmk-layout-shift
      remote: kot149
      revision: v1
      path: modules/zmk-layout-shift

  self:
    path: config
```
